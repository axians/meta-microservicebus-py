## conf/layer.conf
```bitbake
# We have a conf and classes directory, add to BBPATH
BBPATH .= ":${LAYERDIR}"

# We have recipes-* directories, add to BBFILES
BBFILES += "${LAYERDIR}/recipes-*/*/*.bb \
            ${LAYERDIR}/recipes-*/*/*.bbappend"

BBFILE_COLLECTIONS += "meta-microservicebus-py"
BBFILE_PATTERN_meta-microservicebus-py = "^${LAYERDIR}/"
BBFILE_PRIORITY_meta-microservicebus-py = "6"

LAYERDEPENDS_meta-microservicebus-py = "core"
LAYERSERIES_COMPAT_meta-microservicebus-py = "dunfell"
```
